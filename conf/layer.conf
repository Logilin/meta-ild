## conf/layer.conf
```bitbake
# We have a conf and classes directory, add to BBPATH
BBPATH .= ":${LAYERDIR}"

# We have recipes-* directories, add to BBFILES
BBFILES += "${LAYERDIR}/recipes-*/*/*.bb \
            ${LAYERDIR}/recipes-*/*/*.bbappend"

BBFILE_COLLECTIONS += "meta-ild"
BBFILE_PATTERN_meta-ild = "^${LAYERDIR}/"
BBFILE_PRIORITY_meta-ild = "8"

LAYERDEPENDS_meta-ild = "core"
LAYERSERIES_COMPAT_meta-ild = "kirkstone scarthgap"
```
